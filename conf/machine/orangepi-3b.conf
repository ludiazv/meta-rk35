## conf/machine/orangepi-3b.conf
```bitbake
#@TYPE: Machine
#@NAME: Orange Pi 3B
#@DESCRIPTION: ROCK5 is the 5th generation of SBC designed by Radxa.
#https://wiki.radxa.com/Rock5/5b

require conf/machine/include/rk3566.inc




KERNEL_DEVICETREE = "rockchip/rk3566-orangepi-3b.dtb"
MACHINE_EXTRA_RRECOMMENDS += "kernel-modules"



UBOOT_MACHINE = "orangepi-3b-rk3566_defconfig"
```
